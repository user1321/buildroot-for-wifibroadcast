## package/wifibroadcast-rangarid-osd/Config.in
```kconfig
config BR2_PACKAGE_WIFIBROADCAST_OSD_RANGARID
	bool "wifibroadcastosd-rangarid"
	help
	  This will install Rangarid's wifibroadcast osd

	  https://github.com/SamuelBrucksch/wifibroadcast_osd/
```
